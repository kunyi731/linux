## Documentation/devicetree/bindings/hwmon/npcm7xx-fan.txt
```
Nuvoton NPCM7xx fan tachometer (Fan) controller device driver

The NPCM7xx fan tachometer controller supports upto 16 Fan inputs.

Required properties:
- compatible      : "nuvoton,npcm750-fan" for Poleg NPCM750.
- reg             : Offset and length of the register set for the device.
- clocks          : phandle of fan reference clock.
- interrupts      : Contain the fan interrupts with flags for
                    falling edge.

fan: fan@0 {
	compatible = "nuvoton,npcm750-fan";
	reg = <0xf0180000 0x8000>;
	interrupts = <0 96 4>, <0 97 4>, <0 98 4>, <0 99 4>,
		<0 100 4>, <0 101 4>, <0 102 4>, <0 103 4>;
	clocks = <&clk NPCM7XX_CLK_APB4>;
};
```

## Documentation/devicetree/bindings/hwmon/npcm7xx-pwm.txt
```
Nuvoton NPCM7xx Pulse-width modulation (PWM) controller device driver

The NPCM7xx PWM controller supports upto 8 PWM outputs.
Each PWM output module have watchdog.

Required properties:
- compatible      : "nuvoton,npcm750-pwm" for Poleg NPCM750.
- reg             : Offset and length of the registers set for the device.
- clocks          : phandle of pwm reference clock.

pwm:pwm@f0103000 {
	compatible = "nuvoton,npcm750-pwm";
	reg = <0xf0103000 0x1000
				0xf0104000 0x1000>;
	clocks = <&clk NPCM7XX_CLK_APB3>;
};
```

## Documentation/devicetree/bindings/iio/adc/npcm7xx-adc.txt
```
Nuvoton NPCM7XX Analog to Digital Converter (ADC)

The NPCM7XX ADC is a 10-bit converter for eight channel inputs,
The ADC module includes an eight-to-one multiplexer.

Required properties:
- compatible      : "nuvoton,npcm750-adc" for Poleg NPCM750.
- reg             : Offset and length of the register set for the device.

Required clocking property, have to be one of:
- clocks          : phandle of timer reference clock.
- clock-names	  : Must contain "clk_adc", matching entry in the clocks property.
- vref			  : ADC Reference voltage, defualt 2048.

Example:

adc: adc@f000c000 {
	compatible = "nuvoton,npcm750-adc";
	reg = <0xf000c000 0x1000>;
	clocks = <&clk NPCM7XX_CLK_ADC>;
	clock-names = "clk_adc";
	vref = <2048>;
};
```

## Documentation/devicetree/bindings/mtd/npcm-spi.txt
```
* Nuvoton Serial Peripheral Interface(SPI)

Required properties:
  - compatible : "nuvoton,npcm750-spi" for NPCM750 BMC
  - #address-cells : should be 1.
  - #size-cells : should be 0.
  - reg : the first contains the register location and length,
          the second contains the memory mapping address and length
  - reg-names: Should contain the reg names "control" and "memory"
  - clocks : phandle of SPI reference clock.

Optional properties:
  - chip-max-address-map: Chip maximum address mapping for direct use.
  			  the maximum address map size:
			  NPCM7xx - 0x8000000 (128Mb)

Example:

spi0: spi@fb000000 {
	compatible = "nuvoton,npcm750-spi";
	#address-cells = <1>;
	#size-cells = <0>;
	reg = <0xfb000000 0x1000>, <0x80000000 0x10000000>;
	reg-names = "control", "memory";
	chip-max-address-map = <0x8000000>;
	clocks = <&clk NPCM7XX_CLK_AHB>;
	spi-nor@0 {
			...
	};
};
```

## Documentation/devicetree/bindings/serial/nuvoton,npcm-uart.txt
```
Nuvoton NPCM Universal Asynchronous Receiver/Transmitter (UART)

Required properties:
- compatible      : "nuvoton,npcm750-uart" for Poleg NPCM750.
- reg             : Offset and length of the register set for the device.
- interrupts      : Contain the UART interrupt with flags for falling edge.

Required clocking property, have to be one of:
- clocks          : phandle of UART reference clock.
- clock-frequency : The frequency in Hz of the clock that drives the NPCM
                    UART (usually 24000000).

Optional properties:
- reg-shift 	  : quantity to shift the register offsets by (default 2).
- fifo-size 	  : the fifo size of the UART (default 1).

Note: Each uart controller should have an alias correctly numbered
in "aliases" node.

Example:

aliases {
	serial0 = &serial0;
};

serial0: serial0@f0001000 {
	compatible = "nuvoton,npcm750-uart";
	reg = <0xf0001000 0x1000>;
	clocks = <&clk NPCM7XX_CLK_UART_CORE>;
	interrupts = <GIC_SPI 2 IRQ_TYPE_LEVEL_HIGH>;
	reg-shift = <2>;
	fifo-size = <14>;
	status = "disabled";
};
```

## Documentation/devicetree/bindings/watchdog/nuvoton,npcm7xx-wdt.txt
```
Nuvoton NPCM7xx watchdog timer

Nuvoton NPCM7xx have three watchdog timer modules, each watchdog timer is a free-running timer
with programmable timeout intervals.

Required properties:
- compatible      : "nuvoton,npcm750-wdt" for Poleg NPCM750.
- reg             : Offset and length of the register set for the device.
- interrupts      : Contain the timer interrupt with flags for
                    falling edge.

Optional:
- clocks          : phandle of watchdog timer reference clock.

Example:

watchdog0: watchdog@f0008000 {
	compatible = "nuvoton,npcm750-wdt";
	interrupts = <GIC_SPI 47 IRQ_TYPE_LEVEL_HIGH>;
	reg = <0xf0008000 0x1000>;
	status = "disabled";
	clocks = <&clk NPCM7XX_CLK_TIMER>;
};
```
